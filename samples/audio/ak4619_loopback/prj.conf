## CMakeLists.txt
```
cmake_minimum_required(VERSION 3.20.0)

find_package(Zephyr REQUIRED HINTS $ENV{ZEPHYR_BASE})
project(ak4619_loopback)

# The codec driver ships with the sample rather than with the toolkit (issue
# #42), so it is an application source. Its binding lives on the module's
# DTS_ROOT because the board overlay that declares the node is shared with the
# board test suites - see dts/bindings/audio/asahi-kasei,ak4619.yaml.
target_sources_ifdef(CONFIG_AK4619 app PRIVATE drivers/ak4619.c)

target_include_directories(app PRIVATE drivers)

# src/loopback_verdict.c is listed separately from main.c because it is the half
# of this application that has no hardware in it: the native_sim suite under
# tests/samples/ compiles the same file and asserts what it decides (issue #47).
target_sources(app PRIVATE
	src/main.c
	src/loopback_verdict.c
)
```

## Kconfig
```
# Sample application Kconfig root.
#
# SPDX-License-Identifier: Apache-2.0

rsource "drivers/Kconfig"
rsource "Kconfig.loopback"

# A sample application supplies the Kconfig root, so the rest of the tree has to
# be sourced explicitly.
source "Kconfig.zephyr"
```

## Kconfig.loopback
```
# Choices that belong to the loopback application rather than to the codec
# driver, kept in a file of their own because two Kconfig roots need them: the
# sample's, and the native_sim test suite's - the suite compiles src/ of this
# sample, so it has to see the same symbols the sample was written against.
#
# Only what a human at a bench might have to change on the day is here.
# Everything else - the tone frequencies, the analyzer window, the pass/fail
# thresholds - is derived in src/loopback_format.h and src/loopback_verdict.h,
# because those numbers are tied to each other and to the levels in
# docs/hardware/akd4619-evaluation-board.md §4.5. A Kconfig symbol per threshold
# would let them be changed apart, which is the one thing that must not happen.
#
# SPDX-License-Identifier: Apache-2.0

choice
	prompt "I2S slot length on the wire"
	default AK4619_LOOPBACK_SLOT_32
	help
	  How many bit clocks one channel occupies. Both settings run MCLK at
	  256 fs, which is the ratio the AK4619's FS[2:0] = 000 row expects
	  (datasheet p.31, Table 1) and the only one this application uses: the
	  STM32 I2S driver compensates for its own master-clock divider, so
	  MCLK is 256 fs at either slot length and only BICK changes
	  (drivers/i2s/i2s_stm32.c at Zephyr v4.4.1 - `bit_clk_freq *=
	  channel_length == 16U ? 4U * 2U : 4U`).

	  The choice therefore is not about the clock ratio. It is about how
	  wide a word crosses the wire, and the two settings fail differently.

config AK4619_LOOPBACK_SLOT_32
	bool "32-bit slots, BICK 64 fs"
	help
	  The part's own default slot length, and the one that carries the
	  ADC's full 24-bit word: DODL has no 32-bit setting, so the ADC word
	  arrives MSB-justified in the slot with its low 8 bits zero
	  (datasheet p.33 Table 7, p.34 Figure 12).

	  KNOWN RISK, and the reason the other setting exists: Zephyr's STM32
	  I2S driver configures its DMA with a fixed 16-bit transfer width
	  whatever word_size says, so a 32-bit word reaches the peripheral as
	  two halves and the peripheral decides which half is the MSB. If that
	  order is the opposite of the little-endian one the wire seam writes,
	  the loop still runs at the right rate and still carries energy - what
	  comes back is the halves swapped, which the analyzer reports as noise
	  rather than as silence. See the sample's README.

config AK4619_LOOPBACK_SLOT_16
	bool "16-bit slots, BICK 32 fs"
	help
	  The fallback. 32 fs is the bottom of the BICK range FS[2:0] = 000
	  allows (32-256 fs, datasheet p.31), and 16-bit words are the depth
	  Zephyr's STM32 I2S driver moves with a DMA of matching width, so this
	  setting has no half-word order to get wrong. The cost is resolution:
	  the capture is 16-bit, about 96 dB of range instead of 144, which is
	  far more than any threshold in this application depends on.

	  Try this first if the 32-bit run reports energy without a tone.

endchoice
```

## sample.yaml
```
# Twister metadata for the AK4619 sample.
#
# build_only, because the pass/fail this image reports is about a second board
# on the other end of six wires: there is nothing Twister can assert without an
# AKD4619-A attached and a human reading the console. CI builds it for
# nucleo_h723zg so the driver, the binding and the shared overlay stay in step;
# the hardware result goes on the pull request, per AGENTS.md.
#
# platform_allow keeps it off native_sim: the sample resolves the audio-codec
# alias at build time, and only this board's overlay declares one.
sample:
  name: AK4619 analog loopback
  description: >
    Bring an AKM AK4619 up over I2C, program its audio interface, clocking and
    analog paths, then play a two-tone stimulus out through its DAC and capture
    it back through its ADC over a physical cable, and report a verdict: the
    level and the tone each channel came back with, and PASS or FAIL. The run
    is only meaningful in pairs - see README.md, which says to repeat it with
    the loop cable unplugged and keep both consoles.
tests:
  sample.audio.ak4619_loopback:
    build_only: true
    tags:
      - audio
      - board
      - codec
    platform_allow:
      - nucleo_h723zg
    integration_platforms:
      - nucleo_h723zg
```

## prj.conf
```kconfig
# The control bus. CONFIG_I2C is selected by CONFIG_AK4619, which the codec
# node in dts/boards/nucleo_h723zg.overlay turns on by itself, so nothing here
# has to name either - that the driver carries its own dependency is part of
# what makes it movable into drivers/audio/ later.

# Console-visible result. The driver and the pipeline nodes log at INFO;
# src/main.c prints the verdict with printk() so it survives a build with
# logging turned down.
CONFIG_LOG=y

# The two pipelines. CONFIG_I2S arrives through the two I2S node symbols, the
# same way CONFIG_I2C arrives through CONFIG_AK4619: a node's dependency
# belongs to the node's symbol.
#
#   tone_gen -> i2s_out        the stimulus, on the block that drives the clocks
#   i2s_in   -> tone_analyzer  the measurement, on the block that follows them
#
# Nothing else is enabled: a node is only reachable through its *_NODE_DEFINE()
# macro, so these four lines are the whole node set of this image.
CONFIG_AUDIO_PIPELINE=y
CONFIG_AUDIO_PIPELINE_NODE_TONE_GEN=y
CONFIG_AUDIO_PIPELINE_NODE_I2S_OUT=y
CONFIG_AUDIO_PIPELINE_NODE_I2S_IN=y
CONFIG_AUDIO_PIPELINE_NODE_TONE_ANALYZER=y

# Both pipelines are AUDIO_PIPELINE_DEFINE()d and bring their own stack, frame
# buffer and event slots, so CONFIG_AUDIO_PIPELINE_FRAME_SAMPLES sizes only the
# built-in buffer that neither of them claims. Left at its default rather than
# tuned, because tuning it would suggest it mattered here; the figure that does
# is FRAME_SAMPLES in src/main.c, which sizes both frame buffers and both sets
# of transfer blocks.

# The three levels audio_codec_configure() programs - DAC digital volume, ADC
# digital volume and the analog MIC gain - are left at their Kconfig defaults
# on purpose. Those defaults *are* the set #43 §4.5 records, and the pass window
# in src/loopback_format.h is derived from the same symbols - so overriding one
# here would move the measurement and the expectation together, which is right,
# while putting the number in two places, which is not.

# The slot length is a choice rather than a setting: see Kconfig.loopback. The
# default is 32-bit slots. If a run reports energy with no tone in it, rebuild
# with -DCONFIG_AK4619_LOOPBACK_SLOT_16=y; README.md says why.
```

## boards/nucleo_h723zg.overlay
```dts
/*
 * The board's audio configuration lives in dts/boards/nucleo_h723zg.overlay at
 * the repository root, included rather than copied: it is the canonical
 * description of this target (the pin choices, the TX/RX block split, the
 * clock roles, the codec on the control bus and the DMA reachability
 * constraint), and two copies of it would be two things to keep in step. It
 * sits outside both tests/ and samples/ so that neither includes it by
 * reaching into the other. Zephyr's board-overlay lookup finds this file by
 * name, and the preprocessor resolves the quoted path relative to it.
 *
 * SPDX-License-Identifier: Apache-2.0
 */

#include "../../../../dts/boards/nucleo_h723zg.overlay"
```

## src/main.c
```c
/*
 * AK4619 analog loopback: play a tone out through the codec's DAC, capture it
 * back through the codec's ADC over a physical cable, and say on the console
 * whether the loop is good.
 *
 * Issue #47, the ticket the whole #42 batch exists for. #45 brought the part up
 * on the control bus and #46 programmed its interface, clocking and analog
 * paths; this adds the clocks, the audio, and a verdict.
 *
 * WHAT PROVES ANYTHING, AND WHAT DOES NOT
 * ---------------------------------------
 * A passing run means nothing on its own. The AK4619 can route an ADC's output
 * straight into a DAC inside the package (register 0x12), and a configuration
 * regression there would produce a test that passes with no cable attached and
 * verifies nothing at all. #46 disables those paths and this application
 * re-checks them before it starts - but the check that actually settles it is
 * the human's: **run it once with the loop cable in and once with it out, and
 * keep both consoles.** Until the second run has failed, the first has proved
 * nothing. README.md is the procedure.
 *
 * WHY TWO PIPELINES
 * -----------------
 * tone_gen -> i2s_out on one, i2s_in -> tone_analyzer on the other. Each paces
 * itself on its own blocking I2S call, so neither has to know about the other,
 * and the analyzer measures the magnitude of a frequency component, which does
 * not depend on where its window starts - so nothing depends on the two staying
 * aligned either.
 *
 * Both are AUDIO_PIPELINE_DEFINE()d. The subsystem's built-in worker stack,
 * frame buffer and event slots are single-instance and owned rather than shared
 * (manifest §6): audio_pipeline_init() claims each built-in an instance leaves
 * NULL and refuses a second claimant with -EBUSY. Only one of the two would
 * strictly have to bring its own, but a hand-rolled instance that fails at
 * init is a failure with no symptom worth debugging, and two definitions cost
 * two stacks either way.
 *
 * ORDER, AND WHY IT IS THIS WAY ROUND
 * -----------------------------------
 * On this board the STM32 is the clock source (#43 §2): the AK4619's MCLK, BICK
 * and LRCK are input pins and it has no PLL, so nothing is clocked until i2s2
 * starts. The datasheet is equally firm the other way - "After setting the
 * control register, supply the necessary system clock (MCLK, BICK, LRCK) and
 * then release the standby state" (p.39). Both constraints are satisfied by one
 * order and only one:
 *
 *   1. configure the codec over I2C, and confirm it (the part stays in standby)
 *   2. start the playback pipeline: i2s2 begins clocking MCLK, BICK and LRCK
 *   3. start the capture pipeline: i2s3 locks to those clocks
 *   4. ak4619_power_up(): the converters come out of standby into a live clock
 *
 * #36's DIX bring-up ran the inverse of steps 1-2 because there the codec was
 * the clock source. Here it cannot be one.
 *
 * Wiring, switch positions and jumpers: docs/hardware/akd4619-evaluation-board.md.
 * The measurement thresholds: src/loopback_format.h and src/loopback_verdict.h.
 *
 * SPDX-License-Identifier: Apache-2.0
 */

#include <zephyr/audio/audio_nodes.h>
#include <zephyr/audio/audio_pipeline.h>
#include <zephyr/audio/codec.h>
#include <zephyr/device.h>
#include <zephyr/devicetree.h>
#include <zephyr/kernel.h>
#include <zephyr/sys/printk.h>
#include <zephyr/sys/util.h>

#include "ak4619.h"
#include "loopback_format.h"
#include "loopback_verdict.h"

#ifndef CONFIG_AK4619
#error "this sample exists to demonstrate the AK4619 driver - CONFIG_AK4619 must be y"
#endif

/*
 * dts/boards/nucleo_h723zg.overlay aliases audio-codec to the AK4619 node on
 * i2c1, i2s-tx to i2s2 and i2s-rx to i2s3. DEVICE_DT_GET() on them is a
 * build-time reference: a missing alias fails the build here rather than being
 * discovered at run time.
 */
#define CODEC_NODE  DT_ALIAS(audio_codec)
#define I2S_TX_NODE DT_ALIAS(i2s_tx)
#define I2S_RX_NODE DT_ALIAS(i2s_rx)

BUILD_ASSERT(DT_NODE_HAS_STATUS_OKAY(CODEC_NODE),
	     "the audio-codec alias must point at an enabled node");

static const struct device *const codec = DEVICE_DT_GET(CODEC_NODE);

/*
 * Frame size, in TOTAL interleaved samples across both channels (manifest §5),
 * and the transfer blocks each direction gets.
 *
 * 256 total samples is 128 stereo sample sets, 2.67 ms at 48 kHz - short enough
 * that four blocks of it are a latency worth reporting rather than a delay, and
 * long enough that neither pipeline thread wakes up more than ~375 times a
 * second. The block that carries it is ROUND_UP(256 * 4, 32) = 1024 bytes, so
 * four blocks per direction is 8 KiB of transfer buffer in total.
 */
#define FRAME_SAMPLES 256U
#define TX_BLOCKS     4U
#define RX_BLOCKS     4U

/*
 * Each pipeline's own worker thread. Priority 5 is below the main thread's, so
 * the report below runs whenever it has something to say and the two workers
 * have the CPU the rest of the time; they spend nearly all of it blocked in the
 * I2S driver anyway.
 */
#define PIPELINE_STACK_SIZE 2048
#define PIPELINE_PRIORITY   5

/*
 * How long to wait for the capture to produce something, and how long to let it
 * settle once it has.
 *
 * The timeout is what makes a dead clock a diagnosable failure instead of a
 * hang: the two worker threads may block forever inside the I2S driver - that
 * is how they pace themselves - but this thread never does, so a run against a
 * board that is powered but not clocking still reaches its verdict.
 *
 * 2 s is many hundreds of 20 ms windows, so reaching the timeout means nothing
 * arrived rather than that something was slow. The settle wait covers the DAC's
 * soft-start and the ADC's DC-offset high-pass filter, neither of which is
 * instantaneous after RSTN is released.
 */
#define CAPTURE_TIMEOUT_MS 2000
#define CAPTURE_SETTLE_MS  250
#define CAPTURE_POLL_MS    5

/* Playback: a two-tone stimulus into i2s2, which drives the clocks. */
AUDIO_TONE_GEN_NODE_DEFINE(tone_source, AK4619_LOOPBACK_TONE_AMPLITUDE_Q15, 0,
			   AK4619_LOOPBACK_TONE_LCH_HZ, AK4619_LOOPBACK_TONE_RCH_HZ);
AUDIO_I2S_OUT_CLK_CONTROLLER_NODE_DEFINE(i2s_sink, &tone_source, I2S_TX_NODE, FRAME_SAMPLES,
					 TX_BLOCKS);
AUDIO_PIPELINE_DEFINE(playback_pipeline, FRAME_SAMPLES, PIPELINE_STACK_SIZE, PIPELINE_PRIORITY);

/* Capture: i2s3 into the analyzer, which is told to expect the same two tones
 * on the same two channels. Every tone is measured on every channel, which is
 * what turns a swapped pair of wires into a reported swap instead of a pass.
 */
AUDIO_I2S_IN_NODE_DEFINE(i2s_source, I2S_RX_NODE, FRAME_SAMPLES, RX_BLOCKS);
AUDIO_TONE_ANALYZER_NODE_DEFINE(analyzer, &i2s_source, AK4619_LOOPBACK_WINDOW_SAMPLES,
				AK4619_LOOPBACK_TONE_LCH_HZ, AK4619_LOOPBACK_TONE_RCH_HZ);
AUDIO_PIPELINE_DEFINE(capture_pipeline, FRAME_SAMPLES, PIPELINE_STACK_SIZE, PIPELINE_PRIORITY);

static const struct audio_pipeline_config playback_config = {
	.frame_samples = FRAME_SAMPLES,
};

static const struct audio_pipeline_config capture_config = {
	.frame_samples = FRAME_SAMPLES,
};

/*
 * The one format both pipelines are bound to, and the fourth description of the
 * same wire after the codec's, i2s2's and i2s3's.
 *
 * valid_bits_per_sample is what the I2S nodes turn into i2s_config.word_size
 * through the shared wire seam, so this field and the codec's word_size are the
 * same number by construction - which is the whole reason both come from
 * loopback_format.h.
 */
static const struct audio_stream_config stream_format = {
	.sample_rate_hz = AK4619_LOOPBACK_RATE_HZ,
	.channels = AK4619_LOOPBACK_CHANNELS,
	.valid_bits_per_sample = AK4619_LOOPBACK_WORD_BITS,
	.format = AUDIO_SAMPLE_FORMAT_S32_LE,
};

/* The registers the configuration owns, with what each one decides. */
static const struct {
	uint8_t reg;
	const char *what;
} configured_registers[] = {
	{AK4619_REG_PWR_MGMT, "power management (00 = standby, RSTN asserted)"},
	{AK4619_REG_AUDIO_IF_FMT1, "format: TDM/DCF/DSL/BCKP/SDOPH"},
	{AK4619_REG_AUDIO_IF_FMT2, "format: SLOT/DIDL/DODL"},
	{AK4619_REG_SYS_CLK, "FS[2:0]: the MCLK ratio the part expects"},
	{AK4619_REG_MIC_AMP_GAIN1, "ADC1 analog MIC gain, Lch and Rch"},
	{AK4619_REG_ADC1_LCH_VOL, "ADC1 Lch digital volume"},
	{AK4619_REG_ADC1_RCH_VOL, "ADC1 Rch digital volume"},
	{AK4619_REG_ADC_INPUT_SEL, "ADC input select (single-ended AIN1L/AIN1R)"},
	{AK4619_REG_ADC_MUTE_HPF, "ADC mutes and DC-offset HPF"},
	{AK4619_REG_DAC1_LCH_VOL, "DAC1 Lch digital volume"},
	{AK4619_REG_DAC1_RCH_VOL, "DAC1 Rch digital volume"},
	{AK4619_REG_DAC_INPUT_SEL, "DAC source multiplexers - INTERNAL LOOPBACK"},
	{AK4619_REG_DAC_DEEMPHASIS, "DAC de-emphasis (05 = off on both)"},
	{AK4619_REG_DAC_MUTE_FLT, "DAC mutes and digital filter"},
};

/** Channel names, in channel order, for the report. */
static const char *const channel_name[AK4619_LOOPBACK_MAX_CHANNELS] = {"Lch", "Rch"};

/** The frequency each channel is supposed to carry, in the same order. */
static const uint32_t channel_tone_hz[AK4619_LOOPBACK_MAX_CHANNELS] = {
	AK4619_LOOPBACK_TONE_LCH_HZ,
	AK4619_LOOPBACK_TONE_RCH_HZ,
};

BUILD_ASSERT(AK4619_LOOPBACK_CHANNELS <= AK4619_LOOPBACK_MAX_CHANNELS,
	     "every channel needs a name and an expected tone in the two tables above");

/* Tenths of a decibel as text. Printed rather than converted to a float because
 * an image that formats one float pulls the whole soft-float printf in.
 */
#define DB_TEXT_LEN 16

static const char *db_text(char *buf, size_t len, int32_t x10)
{
	int32_t whole = x10 / 10;
	uint32_t frac = (uint32_t)((x10 < 0) ? -(x10 % 10) : (x10 % 10));

	/* -0.5 dB has a whole part of 0, so the sign has to be carried
	 * separately or it would print as 0.5.
	 */
	if (x10 < 0 && whole == 0) {
		(void)snprintk(buf, len, "-0.%u", frac);
	} else {
		(void)snprintk(buf, len, "%d.%u", whole, frac);
	}

	return buf;
}

/* A Q15 fraction as 0.000 .. 1.000, for the in-band energy columns. */
#define FRACTION_TEXT_LEN 8

static const char *fraction_text(char *buf, size_t len, int32_t q15)
{
	uint32_t milli = (uint32_t)(((int64_t)q15 * 1000) / AUDIO_TONE_ANALYZER_UNITY_Q15);

	/* The analyzer normalises against unity, so the ratio is 0.000 .. 1.000 and
	 * two digits are all this ever prints. Saying so keeps the whole part
	 * bounded for the compiler, which otherwise has to assume ten digits and
	 * warns that FRACTION_TEXT_LEN cannot hold them.
	 */
	milli = MIN(milli, 9999U);

	(void)snprintk(buf, len, "%u.%03u", milli / 1000U, milli % 1000U);

	return buf;
}

static void dump_configuration(void)
{
	printk("\nregisters, read back from the part:\n");

	for (size_t i = 0; i < ARRAY_SIZE(configured_registers); i++) {
		uint8_t val = 0;
		int ret = ak4619_reg_read(codec, configured_registers[i].reg, &val);

		if (ret < 0) {
			printk("  0x%02x  <read failed, %d>\n", configured_registers[i].reg, ret);
			continue;
		}

		printk("  0x%02x = 0x%02x  %s\n", configured_registers[i].reg, val,
		       configured_registers[i].what);
	}
}

/*
 * Bring the codec up and program it, leaving it configured and in standby.
 *
 * Every failure here is reported with the board-side thing to check, because
 * this is where a board that is unpowered, unplugged from its supply or still
 * held in power-down shows up - and it shows up before anything can block on a
 * clock that will never run.
 */
static bool bring_up_codec(void)
{
	struct audio_codec_cfg cfg;
	int ret;

	printk("\n--- 1. the codec on the control bus ---\n");
	printk("codec node : %s\n", DT_NODE_FULL_NAME(CODEC_NODE));
	printk("i2c address: 0x%02x\n", (unsigned int)DT_REG_ADDR(CODEC_NODE));

	if (!device_is_ready(codec)) {
		printk("codec      : FAIL - the codec did not initialise\n");
		printk("The driver logged why. The usual causes, in order:\n");
		printk("  1. the evaluation board is not powered (+5 V at J703)\n");
		printk("  2. SW500 was never taken L then H, so PDN is still low\n");
		printk("  3. PORT601 is plugged in and the on-board PIC owns the bus\n");
		printk("  4. SW502-1 is H, selecting SPI instead of I2C\n");
		printk("  5. SW502-2 is H, so the part answers at 0x11, not 0x10\n");
		printk("  6. SCL/SDA are not on TP601/TP602, or there is no common ground\n");
		return false;
	}

	printk("init check : %s\n", ak4619_is_linked(codec) ? "passed at boot" : "not verified");

	ret = ak4619_link_check(codec);
	if (ret < 0) {
		printk("link check : FAIL - write/read/verify failed now (%d)\n", ret);
		printk("An address ACK is not proof; nothing latched the value written.\n");
		return false;
	}

	printk("link check : PASS - the part latched and returned both test patterns\n");

	printk("\n--- 2. the format all four devices are programmed for ---\n");
	printk("rate        : %u Hz, %u ch\n", AK4619_LOOPBACK_RATE_HZ, AK4619_LOOPBACK_CHANNELS);
	printk("slot        : %u bit, BICK %u fs, MCLK %u Hz (%u fs)\n", AK4619_LOOPBACK_WORD_BITS,
	       AK4619_LOOPBACK_BICK_RATIO, AK4619_LOOPBACK_MCLK_HZ, AK4619_LOOPBACK_MCLK_RATIO);
	printk("capture     : %u bit ADC word, MSB-justified in the slot (shift %u)\n",
	       AK4619_LOOPBACK_CAPTURE_BITS, AK4619_LOOPBACK_CAPTURE_SHIFT);
	printk("clock roles : i2s2 drives MCLK/BICK/LRCK; i2s3 and the codec receive them\n");
	printk("levels      : DAC %d half-dB, ADC digital %d half-dB, MIC gain %d dB\n",
	       CONFIG_AK4619_DAC_VOLUME_HALF_DB, CONFIG_AK4619_ADC_VOLUME_HALF_DB,
	       CONFIG_AK4619_MIC_GAIN_DB);

	ak4619_loopback_codec_cfg(&cfg, AUDIO_ROUTE_PLAYBACK_CAPTURE);

	ret = audio_codec_configure(codec, &cfg);
	if (ret < 0) {
		printk("configure   : FAIL - the driver refused this configuration (%d)\n", ret);
		printk("It logged which field it could not program.\n");
		return false;
	}

	printk("configure   : PASS\n");

	dump_configuration();

	ret = ak4619_check_no_internal_loopback(codec);
	if (ret < 0) {
		printk("\ninternal loopback: FAIL - an ADC-to-DAC path is enabled inside the "
		       "part (%d)\n",
		       ret);
		printk("This run would pass with the cable unplugged and would verify "
		       "nothing. See issue #42.\n");
		return false;
	}

	printk("\ninternal loopback: none. Register 0x%02x has both DAC multiplexers on an\n",
	       AK4619_REG_DAC_INPUT_SEL);
	printk("SDIN pin, so the only path from DAC to ADC is the cable between J210 and\n");
	printk("J201/J202. Unplug it and the capture must go silent.\n");

	return true;
}

/* Bind, open and start playing one pipeline. Reported by name so a failure says
 * which of the two it was.
 */
static int start_pipeline(struct audio_pipeline *pipeline,
			  const struct audio_pipeline_config *config, struct audio_node *sink,
			  const char *what)
{
	int ret;

	ret = audio_pipeline_init(pipeline, config, sink);
	if (ret < 0) {
		printk("%s: FAIL - init (%d)\n", what, ret);
		return ret;
	}

	ret = audio_pipeline_set_format(pipeline, &stream_format);
	if (ret < 0) {
		printk("%s: FAIL - set_format (%d)\n", what, ret);
		return ret;
	}

	/* start() opens the chain, which is where each I2S node configures its
	 * direction. A format the node cannot carry is refused here, with the
	 * node's own log line saying which field it was.
	 */
	ret = audio_pipeline_start(pipeline);
	if (ret < 0) {
		printk("%s: FAIL - start (%d)\n", what, ret);
		return ret;
	}

	ret = audio_pipeline_play(pipeline);
	if (ret < 0) {
		printk("%s: FAIL - play (%d)\n", what, ret);
		return ret;
	}

	printk("%s: started\n", what);

	return 0;
}

/* Drain and print whatever a pipeline had to say, so a node error that only
 * showed up as a stopped worker is on the console next to the verdict.
 */
static void report_events(struct audio_pipeline *pipeline, const char *what)
{
	struct audio_pipeline_event event;

	while (audio_pipeline_get_event(pipeline, &event, K_NO_WAIT) == 0) {
		switch (event.type) {
		case AUDIO_PIPELINE_EVENT_ERROR:
			printk("  %s: ERROR event, %d\n", what, event.err);
			break;
		case AUDIO_PIPELINE_EVENT_EOF:
			printk("  %s: EOF event - a live link should never report one\n", what);
			break;
		default:
			printk("  %s: event %d\n", what, (int)event.type);
			break;
		}
	}
}

/*
 * Watch the analyzer until it has something settled to say, or until the
 * timeout says nothing is coming.
 *
 * @param first_audio_ms Receives the delay from the codec leaving standby to the
 *                       first window that was not silent, or -1 if none was.
 *                       That figure is an upper bound on the loop's latency - it
 *                       contains one whole 20 ms window, the transfer blocks in
 *                       both directions and the converters' own group delay -
 *                       and no verdict uses it. It is recorded because a later
 *                       sample-exact comparison will need somewhere to start.
 */
static void await_measurement(struct audio_tone_analyzer_result *result, int64_t *first_audio_ms)
{
	int64_t started = k_uptime_get();
	int64_t elapsed = 0;

	*first_audio_ms = -1;

	while (elapsed < CAPTURE_TIMEOUT_MS) {
		(void)audio_tone_analyzer_get_result(&analyzer, result);

		if (result->windows > 0U && result->verdict != AUDIO_TONE_ANALYZER_VERDICT_NONE &&
		    result->verdict != AUDIO_TONE_ANALYZER_VERDICT_SILENT &&
		    *first_audio_ms < 0) {
			*first_audio_ms = elapsed;
		}

		/* Leave early only once something arrived *and* it has had time
		 * to settle; otherwise run the timeout out, which is what the
		 * unplugged control run does.
		 */
		if (*first_audio_ms >= 0 && elapsed >= CAPTURE_SETTLE_MS) {
			break;
		}

		k_msleep(CAPTURE_POLL_MS);
		elapsed = k_uptime_get() - started;
	}

	(void)audio_tone_analyzer_get_result(&analyzer, result);
}

static void print_measurement(const struct ak4619_loopback_report *report, int64_t first_audio_ms)
{
	char level[DB_TEXT_LEN];
	char in_band_a[FRACTION_TEXT_LEN];
	char in_band_b[FRACTION_TEXT_LEN];
	uint8_t ch;

	printk("\n--- 5. what came back ---\n");

	if (first_audio_ms >= 0) {
		printk("first audio %d ms after the codec left standby. That is an UPPER "
		       "BOUND on\n",
		       (int)first_audio_ms);
		printk("the loop latency - it contains a whole %u sample analyzer window and "
		       "the\n",
		       AK4619_LOOPBACK_WINDOW_SAMPLES);
		printk("transfer blocks in both directions. Record it in §4.6 of the wiring "
		       "document.\n\n");
	} else {
		printk("no window ever carried audio.\n\n");
	}

	printk("        expected      measured      carries      in band at      tonal\n");
	printk("          (RMS)         (RMS)                  %5u %5u Hz\n",
	       AK4619_LOOPBACK_TONE_LCH_HZ, AK4619_LOOPBACK_TONE_RCH_HZ);

	for (ch = 0; ch < report->channels; ch++) {
		const struct ak4619_loopback_channel_report *c = &report->channel[ch];

		printk("  %s   %6s dBFS", channel_name[ch],
		       db_text(level, sizeof(level), AK4619_LOOPBACK_EXPECTED_RMS_DBFS_X10));
		printk("  %6s dBFS", db_text(level, sizeof(level), c->level_dbfs_x10));

		if (c->silent) {
			printk("     silent  ");
		} else if (c->carries < 0) {
			printk("     none    ");
		} else {
			printk("   %6u Hz ", channel_tone_hz[c->carries]);
		}

		/* Two buffers, because both conversions happen before either is
		 * printed and one buffer would print the second value twice.
		 */
		printk("  %5s %5s",
		       fraction_text(in_band_a, sizeof(in_band_a), c->in_band_q15[0]),
		       fraction_text(in_band_b, sizeof(in_band_b), c->in_band_q15[1]));
		printk("   %s\n", c->tonal ? "yes" : "no");
	}

	printk("\nwindows measured: %u of %u samples each\n", report->windows,
	       AK4619_LOOPBACK_WINDOW_SAMPLES);

	if (report->channel_at_fault >= 0) {
		printk("the channel at fault is %s\n", channel_name[report->channel_at_fault]);
	}
}

int main(void)
{
	struct audio_tone_analyzer_result result = {0};
	struct ak4619_loopback_report report = {0};
	int64_t first_audio_ms = -1;
	char level[DB_TEXT_LEN];
	int ret;

	printk("\n=== AK4619 analog loopback: play a tone, capture it back (issue #47) ===\n");

	if (!bring_up_codec()) {
		printk("\n=== RESULT: FAIL - the codec never got as far as being configured "
		       "===\n");
		return 0;
	}

	printk("\n--- 3. what will be played ---\n");
	printk("%s %u Hz, %s %u Hz, both at %s dBFS peak\n", channel_name[0],
	       AK4619_LOOPBACK_TONE_LCH_HZ, channel_name[1], AK4619_LOOPBACK_TONE_RCH_HZ,
	       db_text(level, sizeof(level), AK4619_LOOPBACK_TONE_DBFS_X10));
	printk("expected back: %s dBFS RMS per channel",
	       db_text(level, sizeof(level), AK4619_LOOPBACK_EXPECTED_RMS_DBFS_X10));
	printk(", +/- %s dB\n", db_text(level, sizeof(level), AK4619_LOOPBACK_LEVEL_TOLERANCE_X10));
	printk("pass window  : %s", db_text(level, sizeof(level),
					    AK4619_LOOPBACK_EXPECTED_RMS_DBFS_X10 -
						    AK4619_LOOPBACK_LEVEL_TOLERANCE_X10));
	printk(" .. %s dBFS RMS\n", db_text(level, sizeof(level),
					    AK4619_LOOPBACK_EXPECTED_RMS_DBFS_X10 +
						    AK4619_LOOPBACK_LEVEL_TOLERANCE_X10));
	printk("that expectation is the tone, the DAC volume, the MIC amp and the ADC volume\n");
	printk("added up - change any of them in Kconfig and this line moves with it.\n");

	printk("\n--- 4. starting, in the only order that works ---\n");

	/* Step 2: the transmit block is the clock controller, so this is what
	 * makes MCLK, BICK and LRCK exist at all.
	 */
	ret = start_pipeline(&playback_pipeline, &playback_config, &i2s_sink,
			     "playback (tone_gen -> i2s2)");
	if (ret < 0) {
		printk("\n=== RESULT: FAIL - the playback pipeline would not start ===\n");
		return 0;
	}

	/* Step 3: give the transmit side a moment to have actually queued a
	 * block and triggered START before the receive side goes looking for
	 * the clocks it is a target on.
	 */
	k_msleep(20);

	ret = start_pipeline(&capture_pipeline, &capture_config, &analyzer,
			     "capture  (i2s3 -> tone_analyzer)");
	if (ret < 0) {
		printk("\n=== RESULT: FAIL - the capture pipeline would not start ===\n");
		return 0;
	}

	/* Step 4: and only now may the converters leave standby. */
	ret = ak4619_power_up(codec);
	if (ret < 0) {
		printk("codec power-up: FAIL (%d)\n", ret);
		printk("\n=== RESULT: FAIL - the part would not leave standby ===\n");
		return 0;
	}

	printk("codec out of standby: PASS - DAC1 and ADC1 powered, RSTN released\n");

	await_measurement(&result, &first_audio_ms);

	ret = ak4619_loopback_evaluate(&result, &report);
	if (ret < 0) {
		printk("\n=== RESULT: FAIL - the analyzer result could not be evaluated (%d) "
		       "===\n",
		       ret);
		return 0;
	}

	print_measurement(&report, first_audio_ms);

	printk("\npipeline events:\n");
	report_events(&playback_pipeline, "playback");
	report_events(&capture_pipeline, "capture ");

	/* The verdict goes out before the teardown, so it is on the console even
	 * if a worker stuck on a clock that never came makes the teardown below
	 * take forever.
	 */
	printk("\n=== RESULT: %s ===\n", ak4619_loopback_verdict_name(report.verdict));
	printk("%s\n", ak4619_loopback_verdict_hint(report.verdict));

	printk("\n--- 6. stopping ---\n");
	(void)audio_pipeline_stop(&capture_pipeline);
	(void)audio_pipeline_stop(&playback_pipeline);
	(void)ak4619_power_down(codec);
	printk("codec back in standby\n");

	if (report.verdict == AK4619_LOOPBACK_VERDICT_NO_WINDOW) {
		/* i2s_read() waits forever by design - that wait is how the
		 * source paces itself - so a receive direction that never got a
		 * clock is still inside it, and join() would wait with it. The
		 * verdict is already printed; say why the image stops here
		 * rather than appearing to hang one line later.
		 */
		printk("not joining the pipelines: the capture worker is still blocked in\n");
		printk("i2s_read() waiting for a bit clock that never arrived, and join() "
		       "would\n");
		printk("wait with it. Reset the board.\n");
		return 0;
	}

	(void)audio_pipeline_join(&capture_pipeline);
	(void)audio_pipeline_join(&playback_pipeline);
	printk("both pipelines joined; the I2S blocks are stopped and the clocks are gone\n");

	return 0;
}
```

## src/loopback_format.h
```c
/*
 * The one place the AK4619 loopback's audio format and stimulus are written
 * down.
 *
 * THE POINT OF THIS FILE
 * ----------------------
 * Three devices have to agree about the same wire: i2s2 (transmit, and the
 * clock controller), i2s3 (receive) and the codec. The disagreements are quiet -
 * a bit-depth mismatch shifts the data, a slot mismatch swaps or drops
 * channels, and neither i2s_configure() nor audio_codec_configure() can see
 * the other side to complain. So none of the three gets its own numbers: they
 * all come from here, through ak4619_loopback_codec_cfg() and
 * ak4619_loopback_i2s_cfg(). Issue #46.
 *
 * Issue #47 added the second half: what is played, where the captured sample
 * sits, and therefore what level the measurement should find. Those follow from
 * the same numbers and are derived here rather than written out again beside
 * the code that checks them.
 *
 * WHY THESE NUMBERS
 * -----------------
 * 48 kHz, two channels, I2S frame format, MCLK 256 fs. The MCLK ratio is the
 * one that is not free: the AK4619 has no PLL and FS[2:0] only tells it what it
 * is being fed, and 256 fs is its FS[2:0] = 000 row, legal for 8 kHz..48 kHz
 * (datasheet p.31, Table 1). At 48 kHz that is MCLK 12.288 MHz.
 *
 * Zephyr's STM32 I2S driver delivers 256 fs at *either* slot length, because it
 * compensates for the peripheral's own master-clock divider: `bit_clk_freq *=
 * channel_length == 16U ? 4U * 2U : 4U` (drivers/i2s/i2s_stm32.c, read at
 * v4.4.1, the revision pinned in west.yml). A 16-bit channel length gives a
 * 32 fs bit clock times 8; a 32-bit one gives 64 fs times 4. Both land on
 * 256 fs, so the slot length is a free choice as far as the codec's clock
 * register is concerned - it only moves BICK, and 32 fs and 64 fs are both
 * inside the 32..256 fs the same table allows.
 *
 * (An earlier revision of this file and of docs/hardware §2 said 16-bit words
 * would give 128 fs. That read only the 32-bit branch of the expression above.
 * Corrected by #47; nothing else depended on it, because 32-bit slots are still
 * the default - for the reason below rather than for a clock ratio.)
 *
 * Slot length defaults to 32 bits, which is the part's own default and the only
 * one that carries the ADC's full 24-bit word. CONFIG_AK4619_LOOPBACK_SLOT_16
 * selects 16-bit slots instead; the reason that escape hatch exists is in
 * Kconfig.loopback and in the sample's README, and it is about the host's DMA,
 * not about the codec.
 *
 * Clock roles come from #43 §2 and are not negotiable in either direction:
 * the AK4619's MCLK, BICK and LRCK are input pins, so the STM32 sources all
 * three, i2s2 drives them and i2s3 and the codec receive them.
 *
 * WHERE THE CAPTURED SAMPLE SITS
 * ------------------------------
 * The ADC's longest word is 24 bits - DODL has no 32-bit setting (datasheet
 * p.33, Table 7) - so in a 32-bit slot the part puts its word at the start of
 * the slot and pads with zeros (p.34, Figure 12) and the host reads it
 * MSB-justified with the low 8 bits clear. In a 16-bit slot the word fills the
 * slot exactly.
 *
 * Either way the ADC word ends up at the *top* of the canonical 32-bit
 * container, which is what ak4619_loopback_capture_to_container() states once
 * and everything measuring an amplitude goes through. Getting this wrong is not
 * a rounding error: reading the 24-bit word as if it were right-justified
 * understates the level by 48 dB, which turns a good loop into a failed one.
 *
 * WHERE THE LEVELS LIVE
 * ---------------------
 * The codec's three gain stages are CONFIG_AK4619_DAC_VOLUME_HALF_DB,
 * CONFIG_AK4619_MIC_GAIN_DB and CONFIG_AK4619_ADC_VOLUME_HALF_DB, because they
 * are properties of the codec and the loop cable rather than of the wire
 * format, and the driver programs them itself. The chosen set is recorded in
 * docs/hardware/akd4619-evaluation-board.md §4.5.
 *
 * What is here is what the *application* adds on top - the tone's own amplitude
 * - and the sum of all four, which is the level the capture should come back
 * at. Deriving the expectation from the same symbols the driver programs is the
 * point: change a gain in Kconfig and the threshold moves with it instead of
 * silently becoming wrong.
 *
 * SPDX-License-Identifier: Apache-2.0
 */

#ifndef ZEPHYR_AUDIO_TOOLKIT_SAMPLES_AK4619_LOOPBACK_FORMAT_H_
#define ZEPHYR_AUDIO_TOOLKIT_SAMPLES_AK4619_LOOPBACK_FORMAT_H_

#include <stddef.h>
#include <stdint.h>

#include <zephyr/audio/codec.h>
#include <zephyr/drivers/i2s.h>
#include <zephyr/kernel.h>
#include <zephyr/toolchain.h>

#ifdef __cplusplus
extern "C" {
#endif

/** Sample rate on every one of the three devices, in Hz. */
#define AK4619_LOOPBACK_RATE_HZ 48000U

/** Word and slot length on the wire, in bits (Kconfig.loopback). */
#ifdef CONFIG_AK4619_LOOPBACK_SLOT_16
#define AK4619_LOOPBACK_WORD_BITS 16U
#else
#define AK4619_LOOPBACK_WORD_BITS 32U
#endif

/** Channels per frame: Lch and Rch. */
#define AK4619_LOOPBACK_CHANNELS 2U
/** MCLK as a multiple of fs. FS[2:0] = 000 (datasheet p.31, Table 1). */
#define AK4619_LOOPBACK_MCLK_RATIO 256U
/** MCLK the STM32 emits and the codec is told to expect, in Hz. */
#define AK4619_LOOPBACK_MCLK_HZ (AK4619_LOOPBACK_RATE_HZ * AK4619_LOOPBACK_MCLK_RATIO)
/** BICK as a multiple of fs: channels x slot length. 64 fs, or 32 fs at 16 bit. */
#define AK4619_LOOPBACK_BICK_RATIO (AK4619_LOOPBACK_CHANNELS * AK4619_LOOPBACK_WORD_BITS)

/**
 * Valid bits in a captured sample: the ADC cannot emit more than 24 (p.33), and
 * it cannot emit more than the slot holds either.
 */
#define AK4619_LOOPBACK_CAPTURE_BITS                                                               \
	(AK4619_LOOPBACK_WORD_BITS < 24U ? AK4619_LOOPBACK_WORD_BITS : 24U)
/** Left shift the slot padding puts a captured sample under, inside its slot. */
#define AK4619_LOOPBACK_CAPTURE_SHIFT (AK4619_LOOPBACK_WORD_BITS - AK4619_LOOPBACK_CAPTURE_BITS)

/** Bits in the canonical pipeline container (spec §5.3). */
#define AK4619_LOOPBACK_CONTAINER_BITS 32U

/** Bytes one stereo frame occupies in a transfer block. */
#define AK4619_LOOPBACK_FRAME_BYTES                                                                \
	(AK4619_LOOPBACK_CHANNELS * (AK4619_LOOPBACK_WORD_BITS / 8U))

/**
 * @brief Place an ADC output word where it lands in the canonical container.
 *
 * The one statement of where a captured sample sits, and the only arithmetic in
 * this application that a 48 dB error can hide in.
 *
 * Two shifts compose into it and they are deliberately not written separately
 * at any call site:
 *
 *  1. The part puts its @ref AK4619_LOOPBACK_CAPTURE_BITS word at the *start*
 *     of the slot and pads the rest with zeros, so the slot value is
 *     @c word << AK4619_LOOPBACK_CAPTURE_SHIFT (datasheet p.34, Figure 12).
 *  2. The I2S wire seam carries a slot into the container MSB-aligned, so a
 *     32-bit slot passes through unchanged and a 16-bit one is shifted up by 16
 *     (spec §5.3).
 *
 * Their sum is the same in both cases - the ADC word ends at the top of the
 * container - which is why this is one shift of
 * @c AK4619_LOOPBACK_CONTAINER_BITS - @c AK4619_LOOPBACK_CAPTURE_BITS rather
 * than a case analysis.
 *
 * @param adc_word Signed ADC output word, @ref AK4619_LOOPBACK_CAPTURE_BITS
 *                 wide.
 * @return The container sample the pipeline sees.
 */
static inline int32_t ak4619_loopback_capture_to_container(int32_t adc_word)
{
	/* Shifted through the unsigned domain: left-shifting a negative signed
	 * value is not defined by the C standard, and the two's complement
	 * result is what is wanted.
	 */
	return (int32_t)((uint32_t)adc_word
			 << (AK4619_LOOPBACK_CONTAINER_BITS - AK4619_LOOPBACK_CAPTURE_BITS));
}

/*
 * ---------------------------------------------------------------------------
 * The stimulus, and the level it should come back at
 * ---------------------------------------------------------------------------
 */

/**
 * Peak amplitude of the played tone, as a Q15 fraction of full scale, and the
 * same figure in tenths of a decibel.
 *
 * -3.0 dBFS, which is the ceiling §4.4 of the wiring document sets: the DAC's
 * full-scale output and the ADC's full-scale input are the same number and
 * carry a +-10% spread each, so a 0 dBFS tone would land exactly at the ADC's
 * clipping point with the tolerances free to push it over.
 *
 * The two constants describe one thing and are checked against each other on
 * the host - 32768 * 10^(-3.0/20) = 23198, and 23170 is 1/sqrt(2) of full
 * scale, which is -3.01 dBFS and rounds to the same tenth. The Q15 value is
 * what the tone generator takes; the decibel value is what the expectation
 * below is built from.
 */
#define AK4619_LOOPBACK_TONE_AMPLITUDE_Q15 23170
#define AK4619_LOOPBACK_TONE_DBFS_X10      (-30)

/** Frequency each channel carries, in Hz, in channel order. */
#define AK4619_LOOPBACK_TONE_LCH_HZ 1000U
#define AK4619_LOOPBACK_TONE_RCH_HZ 3000U

/**
 * Analyzer integration window, in samples per channel.
 *
 * 960 at 48 kHz is a 50 Hz bin, so both tones land on whole bins - 1 kHz on bin
 * 20 and 3 kHz on bin 60 - and the measurement is exactly offset invariant
 * rather than nearly so. One window is 20 ms.
 */
#define AK4619_LOOPBACK_WINDOW_SAMPLES 960U

/**
 * The gain the loop applies to the played tone, in tenths of a decibel.
 *
 * Read off the same Kconfig symbols the driver programs into the part, so this
 * cannot drift away from what was actually written to registers 0x04, 0x06/0x07
 * and 0x0E/0x0F. The analog path between the DAC pin and the ADC pin is unity
 * by design (wiring document §4.4: both full scales are 0.858 x AVDD, and the
 * 220 ohm series resistors cost under 0.1 dB into 25 kohm).
 *
 * The digital volumes are in half-decibels, hence x5 to reach tenths; the MIC
 * amplifier's gain is in whole decibels, hence x10.
 */
#define AK4619_LOOPBACK_LOOP_GAIN_DBFS_X10                                                         \
	((CONFIG_AK4619_DAC_VOLUME_HALF_DB * 5) + (CONFIG_AK4619_ADC_VOLUME_HALF_DB * 5) +          \
	 (CONFIG_AK4619_MIC_GAIN_DB * 10))

/**
 * A sine's RMS relative to its peak, in tenths of a decibel: 1/sqrt(2).
 *
 * The analyzer reports RMS and everything above is stated as a peak, so this is
 * the one conversion between them.
 */
#define AK4619_LOOPBACK_SINE_RMS_DBFS_X10 (-30)

/**
 * The level the analyzer should measure on each channel, in tenths of a
 * decibel below full scale, RMS.
 *
 * With the defaults of §4.5 - tone -3.0 dBFS peak, DAC -6.0 dB, MIC amp 0 dB,
 * ADC digital 0 dB - this is -12.0 dBFS RMS, i.e. -9.0 dBFS peak.
 */
#define AK4619_LOOPBACK_EXPECTED_RMS_DBFS_X10                                                      \
	(AK4619_LOOPBACK_TONE_DBFS_X10 + AK4619_LOOPBACK_LOOP_GAIN_DBFS_X10 +                       \
	 AK4619_LOOPBACK_SINE_RMS_DBFS_X10)

/**
 * How far the measured level may sit from the expectation before the run fails,
 * in tenths of a decibel.
 *
 * 4.0 dB, and it is a budget rather than a round number:
 *
 *   1.7 dB  the two full scales, worst pairing. Both the DAC output and the
 *           single-ended ADC input are specified 2.55 / 2.83 / 3.11 Vpp
 *           min/typ/max (datasheet p.11 note *14, p.12 note *15), so a DAC at
 *           its maximum into an ADC at its minimum is 1.7 dB the wrong way.
 *   0.5 dB  the gain stages' own accuracy - two digital volume ladders and the
 *           MIC amplifier's 3 dB steps.
 *   0.1 dB  the 220 ohm series resistors into 25 kohm (wiring document §4.4).
 *   0.3 dB  the cable, its contacts, and the analyzer's window quantisation.
 *   ------
 *   2.6 dB  and 4.0 leaves 1.4 dB of slack.
 *
 * The window it defines is -16.0 .. -8.0 dBFS RMS. That is nowhere near the two
 * failures it has to stay clear of: an unplugged loop reads its own noise floor,
 * tens of decibels below, and a path stuck at full scale reads -3.0.
 */
#define AK4619_LOOPBACK_LEVEL_TOLERANCE_X10 40

/*
 * ---------------------------------------------------------------------------
 * Configuration builders
 * ---------------------------------------------------------------------------
 */

/**
 * @brief Fill in the audio_codec_cfg the AK4619 is configured from.
 *
 * The codec is a clock target in both directions, so both I2S_OPT_*_TARGET
 * bits are set here and are not a caller's choice: the STM32 already drives
 * MCLK, BICK and LRCK, and the AK4619 could not drive them if it wanted to.
 *
 * @param cfg Destination, overwritten in full.
 * @param route Which converters to bring up. AUDIO_ROUTE_BYPASS is not a
 *              value this part has - see the driver.
 */
static inline void ak4619_loopback_codec_cfg(struct audio_codec_cfg *cfg, audio_route_t route)
{
	*cfg = (struct audio_codec_cfg){
		.mclk_freq = AK4619_LOOPBACK_MCLK_HZ,
		.dai_type = AUDIO_DAI_TYPE_I2S,
		.dai_route = route,
		.dai_cfg.i2s = {
			.word_size = AK4619_LOOPBACK_WORD_BITS,
			.channels = AK4619_LOOPBACK_CHANNELS,
			.format = I2S_FMT_DATA_FORMAT_I2S,
			.options = I2S_OPT_BIT_CLK_TARGET | I2S_OPT_FRAME_CLK_TARGET,
			.frame_clk_freq = AK4619_LOOPBACK_RATE_HZ,
			.mem_slab = NULL,
			.block_size = 0,
			.timeout = 0,
		},
	};
}

/**
 * @brief Fill in the i2s_config one of the two STM32 blocks is configured from.
 *
 * Same format fields as ak4619_loopback_codec_cfg() produces, by construction.
 * What differs is the clock role, which is why @p options is a parameter: i2s2
 * transmits and sources the clocks, so it passes 0; i2s3 receives them and
 * passes I2S_OPT_BIT_CLK_TARGET | I2S_OPT_FRAME_CLK_TARGET. Exactly one of the
 * two may drive BICK and LRCK - they are the same wires (#43 §3.2).
 *
 * The application itself no longer calls i2s_configure(): the pipeline's I2S
 * nodes do, from the bound pipeline format. This stays because it is what makes
 * the two descriptions comparable, and the sample's Ztest suite asserts that
 * the format the nodes will produce is the one the codec was programmed for.
 *
 * @param cfg Destination, overwritten in full.
 * @param options Clock role and any other I2S_OPT_* bits for this block.
 * @param slab Memory slab the direction's blocks come from.
 * @param block_size Transfer block size in bytes.
 * @param timeout Block timeout in milliseconds.
 */
static inline void ak4619_loopback_i2s_cfg(struct i2s_config *cfg, i2s_opt_t options,
					   struct k_mem_slab *slab, size_t block_size,
					   int32_t timeout)
{
	*cfg = (struct i2s_config){
		.word_size = AK4619_LOOPBACK_WORD_BITS,
		.channels = AK4619_LOOPBACK_CHANNELS,
		.format = I2S_FMT_DATA_FORMAT_I2S,
		.options = options,
		.frame_clk_freq = AK4619_LOOPBACK_RATE_HZ,
		.mem_slab = slab,
		.block_size = block_size,
		.timeout = timeout,
	};
}

#ifdef __cplusplus
}
#endif

#endif /* ZEPHYR_AUDIO_TOOLKIT_SAMPLES_AK4619_LOOPBACK_FORMAT_H_ */
```
