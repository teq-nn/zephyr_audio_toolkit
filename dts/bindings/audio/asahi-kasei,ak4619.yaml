## samples/audio/ak4619_loopback/drivers/Kconfig
```kconfig
# AK4619 codec driver options.
#
# This fragment is `rsource`d by the sample that owns the driver and by the
# native_sim suite that exercises it, so the two cannot drift apart. It is
# deliberately outside the AUDIO_PIPELINE_* namespace: issue #42 forbids any
# pipeline symbol from mentioning the codec.
#
# SPDX-License-Identifier: Apache-2.0

config AK4619
	bool "AKM AK4619 audio codec"
	default y
	depends on DT_HAS_ASAHI_KASEI_AK4619_ENABLED
	select I2C
	help
	  Driver for the AKM AK4619VN 4-channel audio codec on an I2C control
	  bus. It implements Zephyr's audio_codec API and is built with the
	  sample rather than with the toolkit.

if AK4619

config AK4619_INIT_PRIORITY
	int "AK4619 initialisation priority"
	default 60
	help
	  Device initialisation priority within POST_KERNEL. It must be higher
	  than I2C_INIT_PRIORITY so the control bus exists before the codec
	  tries to use it; the driver asserts that at build time. The default
	  matches Zephyr's own AUDIO_CODEC_INIT_PRIORITY.

config AK4619_PROBE_TIMEOUT_MS
	int "How long to wait for the codec to answer, in milliseconds"
	default 100
	help
	  After the datasheet's mandatory 10 ms settling time (p.31, p.40 note
	  (3)), the driver polls the control bus for this long before giving up
	  and failing initialisation. The allowance exists because PDN is a
	  manual toggle on the AKD4619-A evaluation board and may be thrown
	  slightly after the host has booted; it is bounded so that an unpowered
	  board fails with a message instead of hanging. Set 0 for a single
	  attempt.

comment "Levels audio_codec_configure() programs"

config AK4619_DAC_VOLUME_HALF_DB
	int "DAC digital volume, in half-decibels"
	default -12
	range -230 24
	help
	  Digital volume written to DAC1 and DAC2, both channels, in 0.5 dB
	  steps: -12 is -6.0 dB, 0 is 0.0 dB, 24 is the part's +12.0 dB
	  maximum (datasheet p.51, Table 22).

	  The default of -6.0 dB is the loop cable's only attenuation, and it
	  is not arbitrary. The DAC's full-scale output and the ADC's
	  single-ended full-scale input are the same number and track the same
	  rail - 2.55/2.83/3.11 Vpp min/typ/max, both 0.858 x AVDD (datasheet
	  p.11 note *14, p.12 note *15) - so a 0 dBFS tone out of the DAC lands
	  exactly at ADC full scale, with part-to-part spread the only margin.
	  Worst case that spread is 1.7 dB the wrong way. 6 dB clears it and
	  still leaves the captured tone ~94 dB above the ADC's noise floor.

	  Changing this changes the level issue #47 measures at the ADC. Record
	  the new pair in docs/hardware/akd4619-evaluation-board.md.

config AK4619_ADC_VOLUME_HALF_DB
	int "ADC digital volume, in half-decibels"
	default 0
	range -206 48
	help
	  Digital volume written to both channels of both ADCs, in 0.5 dB
	  steps from 0 = 0.0 dB (datasheet p.46, Table 14). The default leaves
	  the capture path unity so that what issue #47 measures is the analog
	  loop and not a gain the driver added.

config AK4619_MIC_GAIN_DB
	int "MIC Gain AMP gain, in dB"
	default 0
	range -6 27
	help
	  Gain of the analog amplifier every ADC input passes through
	  (datasheet p.43, Figure 23), in 3 dB steps from -6 to +27 (p.42,
	  Table 9). Must be a multiple of 3; the driver asserts that at build
	  time.

	  0 dB makes it a line input: 2.83 Vpp typ full scale, 25 k input
	  impedance (datasheet p.11), which is what the loop cable carries.
	  Every dB added here is a dB of headroom removed from the loop, and a
	  line-level signal into a stage left near +27 dB clips before the
	  converter ever sees a clean sample.

module = AK4619
module-str = AK4619 audio codec
source "subsys/logging/Kconfig.template.log_config"

endif # AK4619
```

## subsys/audio/pipeline/Kconfig
```kconfig
menuconfig AUDIO_PIPELINE
	bool "Zephyr audio pipeline"
	help
	  Enable the pull-based audio pipeline subsystem.

	  This symbol brings in the pipeline core only - the thread, the frame
	  buffer, the event queue and the node dispatch. The nodes shipped with
	  the subsystem are separate symbols under "Nodes" below, so an image
	  carries the ones the application wires up with a *_NODE_DEFINE() macro
	  and nothing else. In particular FILE_SYSTEM is selected by the two file
	  nodes that actually talk to it, not by the pipeline: a target with no
	  storage - the first hardware targets of this module have none - would
	  otherwise pay for a filesystem dispatch layer it can never use.

if AUDIO_PIPELINE

menu "Nodes"

config AUDIO_PIPELINE_NODE_FILE_READER
	bool "File reader source node"
	select FILE_SYSTEM
	help
	  Source node that reads a RIFF/WAVE file through the Zephyr filesystem
	  API. That API is why this symbol, and not AUDIO_PIPELINE, selects
	  FILE_SYSTEM. The select only pulls in the dispatch layer: the
	  application still chooses a filesystem type (ext2, FAT, littlefs, ...)
	  and mounts it before opening the pipeline.

	  Defaults to n like every node symbol here. A node is only reachable
	  through its *_NODE_DEFINE() macro, so an application always knows
	  which nodes it uses and can say so; the reverse - a default the
	  application never asked for - is text nobody can point at. For this
	  node it is also a whole subsystem nobody asked for.

config AUDIO_PIPELINE_NODE_FILE_WRITER
	bool "File writer sink node"
	select FILE_SYSTEM
	help
	  Sink node that writes the stream to a RIFF/WAVE file through the
	  Zephyr filesystem API. As with the reader, the select lives here
	  rather than on AUDIO_PIPELINE because this node is one of the two that
	  need it, and it only pulls in the dispatch layer - the application
	  mounts a filesystem itself.

	  Defaults to n for the same reason as the reader: nodes are opted into
	  explicitly, so the set of nodes in an image is visible in prj.conf.

config AUDIO_PIPELINE_NODE_GAIN_FILTER
	bool "Gain filter node"
	help
	  Filter node that scales every sample by a Q15 gain. Pure arithmetic,
	  no dependencies.

	  Defaults to n so that the node set is opted into explicitly, like
	  every other node symbol here, rather than being cheap enough that
	  nobody notices it. Uniformity is the point: one rule for all four
	  shipped nodes is easier to reason about than a size threshold.

config AUDIO_PIPELINE_NODE_I2S_OUT
	bool "I2S output sink node"
	select I2S
	help
	  Sink node that transmits the stream through a Zephyr I2S device. That
	  API is why this symbol, and not AUDIO_PIPELINE, selects I2S: a node's
	  dependencies belong to the node's symbol, exactly as FILE_SYSTEM
	  belongs to the two file nodes. The select only pulls in the subsystem;
	  the application still enables a driver and describes the peripheral in
	  devicetree, which is also where the node gets its device from.

	  The node is a clock target on every path it has - the codec owns MCLK,
	  BCK and LRCK on the systems this is built for - and there is
	  deliberately no option here to make it a controller.

	  Defaults to n like every other node symbol here, so the set of nodes
	  in an image is visible in prj.conf.

config AUDIO_PIPELINE_NODE_NULL_SINK
	bool "Null sink node"
	help
	  Sink node that discards every frame it is handed. Useful to terminate
	  a chain while bringing a source or a filter up, and it keeps no state.

	  Defaults to n so that the node set is opted into explicitly, like
	  every other node symbol here.

endmenu

config AUDIO_PIPELINE_FRAME_SAMPLES
	int "Samples per frame (total across all channels)"
	default 128
	range 2 1024
	help
	  Size of the shared pipeline frame buffer, counted in TOTAL int32_t
	  samples across all channels - not per channel. Samples are
	  interleaved, so at 2 channels a value of 128 carries 64 sample pairs,
	  and AUDIO_PIPELINE_DEFINE() allocates exactly this many int32_t with
	  no channel multiplier anywhere.

	  Total rather than per channel because the channel count is not known
	  here: it is bound at run time by audio_pipeline_set_format() and owned
	  by the pipeline (manifest §4), so a per-channel figure could not be
	  turned into a buffer size at compile time without a second, static
	  channel-count symbol to disagree with the bound format.

	  Latency per iteration is therefore
	  frame_samples / (sample_rate_hz * channels): 128 total samples at
	  48 kHz stereo is 64 frames, i.e. ~1.33 ms.

	  Default 128 (512 bytes) is kept from the shipped behaviour: it is a
	  comfortable ~1.3 ms of stereo at 48 kHz and it stays a power of two
	  for every channel count in the v1 range. The upper bound of 1024
	  caps the static buffer at 4 KiB.

	  The minimum is 2, not 1: a total frame of 1 sample cannot hold one
	  interleaved sample set for the 2 channels the shipped file nodes
	  accept (their v1 range is 1..2), so it is a value no stereo pipeline
	  could ever use. 2 is the smallest frame that holds one full
	  interleaved sample set for every format those nodes can bind. Node
	  sets with more channels are covered at run time instead, where the
	  channel count is known: audio_pipeline_set_format() refuses a format
	  whose one interleaved sample set does not fit the frame buffer.

config AUDIO_PIPELINE_EVENT_QUEUE_DEPTH
	int "Event queue depth per pipeline"
	default 4
	range 1 32
	help
	  Number of audio_pipeline_event entries the per-pipeline message queue
	  can hold. The storage is allocated statically, either by
	  AUDIO_PIPELINE_DEFINE() or - for a zero-initialised instance - by the
	  subsystem itself. When the queue is full the newest event is dropped,
	  so the oldest ones (and with them the first error) always survive.

config AUDIO_PIPELINE_THREAD_PRIO
	int "Pipeline thread priority"
	default 5
	help
	  Priority assigned to the pipeline worker thread.

config AUDIO_PIPELINE_THREAD_STACK_SIZE
	int "Pipeline thread stack size"
	default 2048
	help
	  Stack size for the pipeline worker thread.

endif
```

## tests/subsys/audio/i2s_wire/testcase.yaml
```yaml
tests:
  audio.pipeline.i2s_wire:
    tags:
      - audio
      - audio_pipeline
      - i2s
    integration_platforms:
      - native_sim
```

## tests/subsys/audio/no_file_nodes/testcase.yaml
```yaml
tests:
  audio.pipeline.no_file_nodes:
    tags:
      - audio
      - audio_pipeline
      - kconfig
    integration_platforms:
      - native_sim
```

## tests/subsys/audio/pipeline/testcase.yaml
```yaml
tests:
  audio.pipeline.core:
    tags:
      - audio
      - audio_pipeline
    integration_platforms:
      - native_sim
```

## tests/subsys/audio/wav/testcase.yaml
```yaml
tests:
  audio.pipeline.wav:
    tags:
      - audio
      - audio_pipeline
      - wav
    integration_platforms:
      - native_sim
```

## tests/subsys/audio/wav_parser/testcase.yaml
```yaml
tests:
  audio.pipeline.wav_parser:
    tags:
      - audio
      - audio_pipeline
      - wav
    integration_platforms:
      - native_sim
```
